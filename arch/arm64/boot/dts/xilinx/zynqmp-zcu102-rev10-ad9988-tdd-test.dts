// SPDX-License-Identifier: GPL-2.0
/*
 * Analog Devices Stingray
 * https://wiki.analog.com/resources/eval/user-guides/quadmxfe/quick-start
 * https://wiki.analog.com/resources/tools-software/linux-drivers/iio-mxfe/ad9081
 *
 * hdl_project: <ad9081_fmca_ebz_x_band/zcu102>
 * board_revision: <>
 *
 * Copyright (C) 2019-2020 Analog Devices Inc.
 */

#include "zynqmp-zcu102-rev10-ad9988-fmcb-m8-l4.dts"

/ {
	model = "Stingray ZynqMP ZCU102 Rev1.0";



	rx_en_ctrl@0 {
		compatible = "adi,one-bit-adc-dac";
	    #address-cells = <1>;
	    #size-cells = <0>;

		out-gpios = <&gpio 134 0>, <&gpio 135 0> ;
		label = "rx_en_ctrl";

	        channel@0 {
				reg = <0>;
				label = "rx_en_ctrl_0";
	        };
			channel@1 {
				reg = <1>;
				label = "rx_en_ctrl_1";
			};
	};


};
